## drivers/misc/mediatek/sensors-1.0/situation/dropdepth_detect/Kconfig
```kconfig
config MTK_DROPDEPTH_DETECT_HUB
	bool "dropdepth detect hub for MediaTek package"
	default n
	help
	  A dropdepth detect is a device, usually portable
	  and electronic or electromechanical, that detect device's dropdepth.
```
